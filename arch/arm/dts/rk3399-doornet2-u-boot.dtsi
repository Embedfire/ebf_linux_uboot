// SPDX-License-Identifier: GPL-2.0+
/*
 * Copyright (c) 2021 EmbedFire <embedfire@embedfire.com>
 */

#include "rk3399-u-boot.dtsi"
#include "rk3399-sdram-lpddr4-100.dtsi"
#include "rk3399-sdram-ddr3-1866.dtsi"

/{
	aliases {
		mmc0 = &sdmmc;
		mmc1 = &sdhci;
	};

	chosen {
		u-boot,spl-boot-order = "same-as-spl", &sdmmc, &sdhci;
	};
};
             
&sdmmc {
	pinctrl-0 = <&sdmmc_bus4 &sdmmc_clk &sdmmc_cmd &sdmmc_cd>;
};


