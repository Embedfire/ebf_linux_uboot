// SPDX-License-Identifier: GPL-2.0+
 /*
  * Copyright 2018 NXP
  */

#include "imx8mm-evk.dts"
#include "imx8mm-evk-u-boot.dtsi"

/ {
	model = "NXP i.MX8MM DDR4 EVK board";
};

&flexspi{
	status = "disabled";
};
