## arch/arm/mach-stm32mp/Kconfig
```kconfig
if ARCH_STM32MP

config SPL
	select SPL_BOARD_INIT
	select SPL_CLK
	select SPL_DM
	select SPL_DM_SEQ_ALIAS
	select SPL_DRIVERS_MISC_SUPPORT
	select SPL_FRAMEWORK
	select SPL_GPIO_SUPPORT
	select SPL_LIBCOMMON_SUPPORT
	select SPL_LIBGENERIC_SUPPORT
	select SPL_OF_CONTROL
	select SPL_OF_TRANSLATE
	select SPL_PINCTRL
	select SPL_REGMAP
	select SPL_DM_RESET
	select SPL_SERIAL_SUPPORT
	select SPL_SPI_LOAD
	select SPL_SYSCON
	select SPL_WATCHDOG_SUPPORT
	imply BOOTSTAGE_STASH if SPL_BOOTSTAGE
	imply SPL_BOOTSTAGE
	imply SPL_DISPLAY_PRINT
	imply SPL_LIBDISK_SUPPORT

config SYS_SOC
	default "stm32mp"

config TARGET_STM32MP1
	bool "Support stm32mp1xx"
	select ARCH_SUPPORT_PSCI if !STM32MP1_TRUSTED
	select CPU_V7A
	select CPU_V7_HAS_NONSEC if !STM32MP1_TRUSTED
	select CPU_V7_HAS_VIRT
	select OF_BOARD_SETUP
	select PINCTRL_STM32
	select STM32_RCC
	select STM32_RESET
	select STM32_SERIAL
	imply BOOTCOUNT_LIMIT
	imply SYSRESET_PSCI if STM32MP1_TRUSTED
	imply SYSRESET_SYSCON if !STM32MP1_TRUSTED
	help
		target STMicroelectronics SOC STM32MP1 family
		STM32MP153 or STM32MP151
		STMicroelectronics MPU with core ARMv7
		dual core A7 for STM32MP153, monocore for STM32MP151

config STM32MP1_RESET_HALT_WORKAROUND
	bool "workaround for reset halt deubg on stm32mp15x"
	depends on TARGET_STM32MP1
	default y
	help
		Activate a workaround for current STM32MP15x revision B
		limitation on debug reset halt not handle by ROM code:
		add a delay loop early in the SPL boot process to wait for
		the debugger to attach
		it can be removed when using the Soc revision
		that fixes the limitation.


config STM32MP1_TRUSTED
	bool "Support trusted boot with TF-A"
	default y if !SPL
	select ARM_SMCCC
	help
		Say Y here to enable boot with TF-A
		Trusted boot chain is :
		BootRom => TF-A.stm32 (clock & DDR) => U-Boot.stm32
		TF-A monitor provide ST smc to manage secure devices

config STM32MP1_OPTEE
	bool "Support trusted boot with TF-A and OPTEE"
	depends on STM32MP1_TRUSTED
	default n
	help
		Say Y here to enable boot with TF-A and OPTEE
		Trusted boot chain is :
		BootRom => TF-A.stm32 (clock & DDR) => OPTEE => U-Boot.stm32
		OPTEE monitor provide ST smc to manage secure devices

config SYS_MMCSD_RAW_MODE_U_BOOT_PARTITION_MMC2
	hex "Partition to use for MMC2 to load U-Boot from"
	depends on SYS_MMCSD_RAW_MODE_U_BOOT_USE_PARTITION && TARGET_STM32MP1
	default 1
	help
	  Partition on the MMC2 to load U-Boot from when the MMC2 is being
	  used in raw mode

config STM32_ETZPC
	bool "STM32 Extended TrustZone Protection"
	depends on TARGET_STM32MP1
	default y
	help
	  Say y to enable STM32 Extended TrustZone Protection
	  Controller (ETZPC)

source "board/st/stm32mp1/Kconfig"

config CMD_STM32PROG
	bool "command stm32prog for STM32CudeProgrammer"
	default y
	depends on CMD_DFU
	imply CMD_GPT if MMC
	imply DFU_MMC if MMC
	imply DFU_NAND if NAND
	select DFU_RAM
	imply DFU_SF if DM_SPI_FLASH
	select DFU_VIRT
	select PARTITION_TYPE_GUID
	help
		activate a specific command stm32prog for STM32MP soc family
		witch update the device with the tools STM32CubeProgrammer,
		using UART with STM32 protocol or USB with DFU protocol
		NB: access to not volatile memory (NOR/NAND/SD/eMMC) is based
		    on U-Boot DFU framework

config CMD_STM32KEY
	bool "command stm32key to fuse public key hash"
	default y
	depends on CMD_FUSE
	help
		fuse public key hash in corresponding fuse used to authenticate
		binary.

config SYS_TEXT_BASE
	prompt "U-Boot base address"
	default 0xC0100000
	help
		configure the U-Boot base address
		when DDR driver is used:
		  DDR + 1MB (0xC0100000)

config NR_DRAM_BANKS
	default 1

config BOOTSTAGE_STASH_ADDR
	default 0xC3000000


if BOOTCOUNT_LIMIT
config SYS_BOOTCOUNT_SINGLEWORD
	default y

# TAMP_BOOTCOUNT = TAMP_BACKUP_REGISTER(21)
config SYS_BOOTCOUNT_ADDR
	default 0x5C00A154
endif

if DEBUG_UART
# debug on UART4 by default
config DEBUG_UART_BASE
	default 0x40010000

# clock source is HSI on reset
config DEBUG_UART_CLOCK
	default 64000000

# currently activated for debug / should be deactivated for real product
config DEBUG_UART_BOARD_INIT
	default y
endif

endif
```

## board/embedfire/doornet2/Kconfig
```kconfig
if TARGET_DOORNET2_RK3399

config SYS_BOARD
	default "doornet2"

config SYS_VENDOR
	default "embedfire"

config SYS_CONFIG_NAME
	default "doornet2"

config BOARD_SPECIFIC_OPTIONS
	def_bool y

endif
```

## board/freescale/imx8mm_fire/Kconfig
```kconfig
if TARGET_IMX8MM_FIRE || TARGET_IMX8MM_DDR4_FIRE

config SYS_BOARD
	default "imx8mm_fire"

config SYS_VENDOR
	default "freescale"

config SYS_CONFIG_NAME
	default "imx8mm_fire"

source "board/freescale/common/Kconfig"

endif
```

## board/freescale/mx6ullfire/Kconfig
```kconfig
if TARGET_MX6ULL_FIRE

config SYS_BOARD
	default "mx6ullfire"

config SYS_VENDOR
	default "freescale"

config SYS_CONFIG_NAME
	default "mx6ullfire"

endif
```

## board/st/stm32mp1/Kconfig
```kconfig
if TARGET_STM32MP1

config SYS_BOARD
	default "stm32mp1"

config SYS_VENDOR
	default "st"

config SYS_CONFIG_NAME
	default "stm32mp1"

config CMD_STBOARD
	bool "stboard - command for OTP board information"
	default y
	help
	  This compile the stboard command to
	  read and write the board in the OTP.

config TARGET_STM32MP157C_DK2
	bool "support of STMicroelectronics STM32MP157C-DK2 Discovery Board"
	default y

endif
```

## drivers/ramblock/Kconfig
```kconfig
config RAMBLOCK
	bool "Enable RAMBLOCK using Driver Model"
	depends on DM
	help
	  Use RAM to simulate block devices
```
