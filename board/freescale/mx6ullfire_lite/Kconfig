## board/freescale/mx6ullfire_lite/Kconfig
```kconfig
if TARGET_MX6ULL_FIRE_LITE

config SYS_BOARD
	default "mx6ullfire_lite"

config SYS_VENDOR
	default "freescale"

config SYS_CONFIG_NAME
	default "mx6ullfire_lite"

endif
```
